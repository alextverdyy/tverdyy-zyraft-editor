## config/boards/shields/zyraft/Kconfig.defconfig
```kconfig
# Zyra FT dongle config
if SHIELD_ZYRAFT_DONGLE
config ZMK_KEYBOARD_NAME
    default "Zyra FT DGL"

config ZMK_SPLIT_ROLE_CENTRAL
    default y
endif

if SHIELD_ZYRAFT_LEFT || SHIELD_ZYRAFT_RIGHT
config ZMK_SPLIT_ROLE_CENTRAL
    default n
endif

if SHIELD_ZYRAFT_LEFT
config ZMK_KEYBOARD_NAME
    default "Zyra FT L"
endif

if SHIELD_ZYRAFT_RIGHT
config ZMK_KEYBOARD_NAME
    default "Zyra FT R"
endif

# Split enabled for all three shields
if SHIELD_ZYRAFT_LEFT || SHIELD_ZYRAFT_RIGHT || SHIELD_ZYRAFT_DONGLE
config ZMK_SPLIT
    default y

config ZMK_BLE
    default y

endif
```

## config/west.yml
```yaml
manifest:
  remotes:
    - name: zmkfirmware
      url-base: https://github.com/zmkfirmware
    - name: urob
      url-base: https://github.com/urob
    - name: carrefinho
      url-base: https://github.com/carrefinho
    - name: dhruvinsh
      url-base: https://github.com/dhruvinsh
    - name: mentaldesk
      url-base: https://github.com/mentaldesk
    - name: caksoylar
      url-base: https://github.com/caksoylar
  projects:
    - name: zmk
      remote: zmkfirmware
      revision: main
      import: app/west.yml
    - name: zmk-helpers
      remote: urob
      revision: main
    - name: zmk-unicode
      remote: urob
      revision: main
    - name: zmk-auto-layer
      remote: urob
      revision: main
    - name: zmk-adaptive-key
      remote: urob
      revision: main
    - name: zmk-leader-key
      remote: urob
      revision: main
    - name: zmk-tri-state
      remote: dhruvinsh
      revision: main
    - name: oskey
      remote: mentaldesk
      revision: main
    - name: zmk-smart-toggle
      remote: caksoylar
      revision: main
    - name: prospector-zmk-module
      remote: carrefinho
      revision: feat/new-status-screens
  self:
    path: config
```
